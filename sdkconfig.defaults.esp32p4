## sdkconfig.defaults.esp32p4
```kconfig
CONFIG_SPIRAM=y

CONFIG_CAMERA_OV9281=y
CONFIG_CAMERA_OV9281_AUTO_DETECT_MIPI_INTERFACE_SENSOR=y

CONFIG_CAMERA_VD56G3=y
CONFIG_CAMERA_VD56G3_AUTO_DETECT_MIPI_INTERFACE_SENSOR=y

CONFIG_ESP32P4_SELECTS_REV_LESS_V3=y
CONFIG_ESP32P4_REV_MIN_100=y
```
